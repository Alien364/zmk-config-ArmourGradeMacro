## config/boards/shields/ArmourGradeMacro/Kconfig.defconfig
```kconfig
if SHIELD_ARMOURGRADEMACRO

config ZMK_KEYBOARD_NAME
    default "ArmourGrade9"

endif
```

## config/boards/shields/ArmourGradeMacro/Kconfig.shield
```kconfig
config SHIELD_ARMOURGRADEMACRO
    def_bool $(shields_list_contains,ArmourGradeMacro)
```
